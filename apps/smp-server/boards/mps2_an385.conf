## apps/smp-server/boards/mps2_an385.conf
```kconfig
# mps2/an385 board tweaks for the SMP fixtures.

# The flash simulator backs the MCUboot partitions and the littlefs storage
# partition defined in mps2_an385.overlay (not enabled in the board defconfig).
CONFIG_FLASH_SIMULATOR=y

# Keep the interactive shell off uart0 (dummy backend) so the shell command
# group can be exercised over SMP without the shell stealing the SMP UART.
# The shell *transport* fixture re-enables the serial backend in shell.conf.
CONFIG_SHELL_BACKEND_SERIAL=n
CONFIG_SHELL_BACKEND_DUMMY=y
```

## apps/smp-server/boards/native_sim.conf
```kconfig
# Native simulator board-specific configuration
# This file contains configurations specific to the native_sim platform

# UART PTY configuration for serial transport
# The UART driver is automatically enabled when CONFIG_SERIAL=y and the
# devicetree contains a uart node with compatible = "zephyr,native-pty-uart"

# Enable serial driver support
CONFIG_SERIAL=y

# Enable UART PTY driver (creates /dev/pts/X pseudo-terminal)
CONFIG_UART_NATIVE_PTY=y

# Use a dedicated PTY instead of stdin/stdout for easier connection from host tools
CONFIG_UART_NATIVE_PTY_0_ON_OWN_PTY=y

# Console configuration for native_sim
# Keep console enabled but don't use it on UART (use POSIX arch console instead)
CONFIG_UART_CONSOLE=n
CONFIG_POSIX_ARCH_CONSOLE=y

# Disable shell backend on serial (shell uses dummy backend instead)
CONFIG_SHELL_BACKEND_SERIAL=n

# MCUboot is not supported on native_sim
# Note: MCUBOOT_UTIL_LOG_LEVEL config is not available without MCUboot,
# so we cannot set it to suppress warnings
```

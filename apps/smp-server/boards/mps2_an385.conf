## west.yml
```yaml
# Copyright (c) 2021 Nordic Semiconductor ASA
# Copyright (c) 2025 Intercreate, Inc.
# SPDX-License-Identifier: Apache-2.0

manifest:
  remotes:
    - name: zephyrproject-rtos
      url-base: https://github.com/zephyrproject-rtos

  projects:
    - name: zephyr
      remote: zephyrproject-rtos
      revision: f33aa2bc4a430e0a330a30cde38c35aea184962a
      import:
        name-allowlist:
          - cmsis_6
          - hal_nordic
          - hal_nxp
          - hal_stm32
          - hal_ti
          - littlefs
          - mbedtls
          - mcuboot
          - tf-psa-crypto
          - zcbor
```

## apps/smp-server/sample.yaml
```yaml
sample:
  name: SMP Server Fixtures
  description: >-
    SMP (MCUmgr) server fixtures for exercising smpclient / smpmgr transports
    without hardware. native_sim and QEMU fixtures are runnable in CI; hardware
    fixtures are build-only images for a bench. Single source of truth: built
    locally with `west twister -T apps` and fanned out across CI legs.
common:
  build_only: true
  tags: smp_server fixture
tests:
  # ---------------------------------------------------------------------------
  # Base fixtures: every MCUmgr command group the target can host, default
  # buffers. The broadest fixtures for exercising specific commands.
  # ---------------------------------------------------------------------------

  # native_sim: 32-bit on purpose -- the 64-bit native_sim PTY UART does not
  # deliver RX to the MCUmgr transport on v4.4.0 (boots but never answers SMP).
  # No MCUboot, so no img group; fs uses littlefs on the flash simulator.
  smp_server.fixture.serial.native_sim:
    sysbuild: false
    platform_allow: [native_sim]
    integration_platforms: [native_sim]
    extra_args:
      - >-
        EXTRA_CONF_FILE="serial.conf;
        grp_os.conf;
        grp_fs.conf;
        grp_shell.conf;
        grp_stat.conf;
        grp_settings.conf;
        grp_enum.conf;
        grp_zbasic.conf"

  smp_server.fixture.serial_raw.native_sim:
    sysbuild: false
    platform_allow: [native_sim]
    integration_platforms: [native_sim]
    extra_args:
      - >-
        EXTRA_CONF_FILE="raw_serial.conf;
        grp_os.conf;
        grp_shell.conf;
        grp_stat.conf;
        grp_settings.conf;
        grp_enum.conf;
        grp_zbasic.conf"

  smp_server.fixture.udp.native_sim:
    sysbuild: false
    platform_allow: [native_sim]
    integration_platforms: [native_sim]
    extra_args:
      - >-
        EXTRA_CONF_FILE="udp.conf;
        nsos.conf;
        grp_os.conf;
        grp_fs.conf;
        grp_shell.conf;
        grp_stat.conf;
        grp_settings.conf;
        grp_enum.conf;
        grp_zbasic.conf"

  # QEMU: merged MCUboot + signed app, runnable in CI -- exercises serial + the
  # img (DFU) group. Serial is a host PTY when launched with QEMU_PTY=1. nRF51
  # has 16 KB RAM, so the RAM-heavy groups are omitted here.
  smp_server.fixture.serial.qemu_cortex_m0:
    sysbuild: true
    platform_allow: [qemu_cortex_m0]
    integration_platforms: [qemu_cortex_m0]
    extra_args:
      - >-
        EXTRA_CONF_FILE="serial.conf;
        grp_os.conf;
        grp_stat.conf;
        grp_enum.conf;
        grp_img.conf"
      - SB_CONFIG_BOOTLOADER_MCUBOOT=y
      - SB_CONFIG_BOOT_SIGNATURE_TYPE_NONE=y
      - SB_CONFIG_MERGED_HEX_FILES=y

  # Hardware: build-only signed images for a bench. Every group enabled.
  smp_server.fixture.serial.nrf52840dk:
    sysbuild: true
    platform_allow: [nrf52840dk/nrf52840]
    integration_platforms: [nrf52840dk/nrf52840]
    extra_args:
      - >-
        EXTRA_CONF_FILE="serial.conf;
        grp_os.conf;
        grp_fs.conf;
        grp_shell.conf;
        grp_stat.conf;
        grp_settings.conf;
        grp_enum.conf;
        grp_zbasic.conf;
        grp_img.conf"
      - SB_CONFIG_BOOTLOADER_MCUBOOT=y
      - SB_CONFIG_MERGED_HEX_FILES=y

  smp_server.fixture.ble.nrf52840dk:
    sysbuild: true
    tags: smp_server fixture bluetooth
    platform_allow: [nrf52840dk/nrf52840]
    integration_platforms: [nrf52840dk/nrf52840]
    extra_args:
      - >-
        EXTRA_CONF_FILE="bt.conf;
        grp_os.conf;
        grp_fs.conf;
        grp_shell.conf;
        grp_stat.conf;
        grp_settings.conf;
        grp_enum.conf;
        grp_zbasic.conf;
        grp_img.conf"
      - SB_CONFIG_BOOTLOADER_MCUBOOT=y
      - SB_CONFIG_MERGED_HEX_FILES=y

  # ---------------------------------------------------------------------------
  # Buffer-size matrix: sweep CONFIG_MCUMGR_TRANSPORT_NETBUF_SIZE to validate
  # smpclient's Auto math (mtu == buf_size, line_buffers = buf_size //
  # line_length) and full fragmentation + reassembly at each size, including a
  # non-multiple of the client line length (400) and an edge below it (96).
  # native_sim serial bakes in a generous UART RX pool (bigrx.conf) so
  # multi-fragment messages arrive without the PTY-burst fragment drop.
  # ---------------------------------------------------------------------------
  smp_server.fixture.serial_buf96.native_sim:
    sysbuild: false
    platform_allow: [native_sim]
    integration_platforms: [native_sim]
    extra_args:
      - &nsim_serial_core >-
        EXTRA_CONF_FILE="serial.conf;
        bigrx.conf;
        grp_os.conf;
        grp_stat.conf;
        grp_enum.conf"
      - CONFIG_MCUMGR_TRANSPORT_NETBUF_SIZE=96

  smp_server.fixture.serial_buf128.native_sim:
    sysbuild: false
    platform_allow: [native_sim]
    integration_platforms: [native_sim]
    extra_args:
      - *nsim_serial_core
      - CONFIG_MCUMGR_TRANSPORT_NETBUF_SIZE=128

  smp_server.fixture.serial_buf256.native_sim:
    sysbuild: false
    platform_allow: [native_sim]
    integration_platforms: [native_sim]
    extra_args:
      - *nsim_serial_core
      - CONFIG_MCUMGR_TRANSPORT_NETBUF_SIZE=256

  smp_server.fixture.serial_buf400.native_sim:
    sysbuild: false
    platform_allow: [native_sim]
    integration_platforms: [native_sim]
    extra_args:
      - *nsim_serial_core
      - CONFIG_MCUMGR_TRANSPORT_NETBUF_SIZE=400

  smp_server.fixture.serial_buf512.native_sim:
    sysbuild: false
    platform_allow: [native_sim]
    integration_platforms: [native_sim]
    extra_args:
      - *nsim_serial_core
      - CONFIG_MCUMGR_TRANSPORT_NETBUF_SIZE=512

  smp_server.fixture.serial_buf1024.native_sim:
    sysbuild: false
    platform_allow: [native_sim]
    integration_platforms: [native_sim]
    extra_args:
      - *nsim_serial_core
      - CONFIG_MCUMGR_TRANSPORT_NETBUF_SIZE=1024

  smp_server.fixture.serial_buf2048.native_sim:
    sysbuild: false
    platform_allow: [native_sim]
    integration_platforms: [native_sim]
    extra_args:
      - *nsim_serial_core
      - CONFIG_MCUMGR_TRANSPORT_NETBUF_SIZE=2048

  smp_server.fixture.udp_buf256.native_sim:
    sysbuild: false
    platform_allow: [native_sim]
    integration_platforms: [native_sim]
    extra_args:
      - &nsim_udp_core >-
        EXTRA_CONF_FILE="udp.conf;
        nsos.conf;
        grp_os.conf;
        grp_stat.conf;
        grp_enum.conf"
      - CONFIG_MCUMGR_TRANSPORT_NETBUF_SIZE=256

  smp_server.fixture.udp_buf1024.native_sim:
    sysbuild: false
    platform_allow: [native_sim]
    integration_platforms: [native_sim]
    extra_args:
      - *nsim_udp_core
      - CONFIG_MCUMGR_TRANSPORT_NETBUF_SIZE=1024

  smp_server.fixture.udp_buf2048.native_sim:
    sysbuild: false
    platform_allow: [native_sim]
    integration_platforms: [native_sim]
    extra_args:
      - *nsim_udp_core
      - CONFIG_MCUMGR_TRANSPORT_NETBUF_SIZE=2048

  # QEMU serial buffer points (plain image, no MCUboot -- isolates transport
  # buffer behavior on an emulated MCU whose UART paces the link).
  smp_server.fixture.serial_buf256.qemu_cortex_m0:
    sysbuild: false
    platform_allow: [qemu_cortex_m0]
    integration_platforms: [qemu_cortex_m0]
    extra_args:
      - &qemu_serial_core >-
        EXTRA_CONF_FILE="serial.conf;
        grp_os.conf;
        grp_stat.conf;
        grp_enum.conf"
      - CONFIG_MCUMGR_TRANSPORT_NETBUF_SIZE=256

  smp_server.fixture.serial_buf512.qemu_cortex_m0:
    sysbuild: false
    platform_allow: [qemu_cortex_m0]
    integration_platforms: [qemu_cortex_m0]
    extra_args:
      - *qemu_serial_core
      - CONFIG_MCUMGR_TRANSPORT_NETBUF_SIZE=512

  # ---------------------------------------------------------------------------
  # Transport / parameter behavior variants.
  # ---------------------------------------------------------------------------

  # Larger UART RX pool, default netbuf: a drop-in serial.native_sim that can
  # receive full multi-fragment messages (smpclient #73/#81). Every group on.
  smp_server.fixture.serial_bigrx.native_sim:
    sysbuild: false
    platform_allow: [native_sim]
    integration_platforms: [native_sim]
    extra_args:
      - >-
        EXTRA_CONF_FILE="serial.conf;
        bigrx.conf;
        grp_os.conf;
        grp_fs.conf;
        grp_shell.conf;
        grp_stat.conf;
        grp_settings.conf;
        grp_enum.conf;
        grp_zbasic.conf"

  # Accepts long serial frame lines (512 B) for manual BufferParams(line_length).
  smp_server.fixture.serial_line512.native_sim:
    sysbuild: false
    platform_allow: [native_sim]
    integration_platforms: [native_sim]
    extra_args:
      - >-
        EXTRA_CONF_FILE="serial.conf;
        line512.conf;
        grp_os.conf;
        grp_stat.conf;
        grp_enum.conf"

  # MCUmgr params command disabled: MCUMgrParametersRead is unsupported, so
  # smpclient falls back to BufferParams defaults. noparams.conf is last so it
  # overrides grp_os.conf.
  smp_server.fixture.serial_noparams.native_sim:
    sysbuild: false
    platform_allow: [native_sim]
    integration_platforms: [native_sim]
    extra_args:
      - >-
        EXTRA_CONF_FILE="serial.conf;
        bigrx.conf;
        grp_os.conf;
        grp_stat.conf;
        grp_enum.conf;
        noparams.conf"

  # SMP over the Zephyr shell: SMP shares the UART with the shell prompt, echo,
  # and log output -- stresses smpclient's SMP/serial demux.
  # Only native_sim: shell + SMP + logging overflows the nRF51 (16 KB) QEMU.
  smp_server.fixture.shell.native_sim:
    sysbuild: false
    platform_allow: [native_sim]
    integration_platforms: [native_sim]
    extra_args:
      - >-
        EXTRA_CONF_FILE="shell.conf;
        grp_os.conf;
        grp_stat.conf;
        grp_enum.conf"

  # UDP over IPv6, reachable at [::1]:1337 (smpclient's IPv6 UDP path).
  smp_server.fixture.udp6.native_sim:
    sysbuild: false
    platform_allow: [native_sim]
    integration_platforms: [native_sim]
    extra_args:
      - >-
        EXTRA_CONF_FILE="udp6.conf;
        nsos.conf;
        grp_os.conf;
        grp_stat.conf;
        grp_enum.conf"

  # ---------------------------------------------------------------------------
  # Runnable filesystem fixtures: littlefs mounted at /lfs1 on the native_sim
  # flash simulator, for fs-group file upload/download round-trips.
  # ---------------------------------------------------------------------------
  smp_server.fixture.serial_fs.native_sim:
    sysbuild: false
    platform_allow: [native_sim]
    integration_platforms: [native_sim]
    extra_args:
      - >-
        EXTRA_CONF_FILE="serial.conf;
        bigrx.conf;
        grp_os.conf;
        grp_fs.conf;
        grp_stat.conf;
        grp_enum.conf"
      - CONFIG_MCUMGR_TRANSPORT_NETBUF_SIZE=1024

  smp_server.fixture.udp_fs.native_sim:
    sysbuild: false
    platform_allow: [native_sim]
    integration_platforms: [native_sim]
    extra_args:
      - >-
        EXTRA_CONF_FILE="udp.conf;
        nsos.conf;
        grp_os.conf;
        grp_fs.conf;
        grp_stat.conf;
        grp_enum.conf"

  # ---------------------------------------------------------------------------
  # Roomier emulated MCU: mps2/an385 (QEMU Cortex-M3, 4 MB SRAM). A flash
  # overlay (boards/mps2_an385.overlay) gives a writable littlefs storage
  # partition, so a single runnable emulated image hosts every non-img group,
  # fs file round-trips, and large buffers -- the RAM-heavy combination the
  # nRF51 QEMU cannot. The board conf keeps the interactive shell off uart0.
  # ---------------------------------------------------------------------------
  smp_server.fixture.serial.mps2_an385:
    sysbuild: false
    platform_allow: [mps2/an385]
    integration_platforms: [mps2/an385]
    extra_args:
      - >-
        EXTRA_CONF_FILE="serial.conf;
        grp_os.conf;
        grp_fs.conf;
        grp_shell.conf;
        grp_stat.conf;
        grp_settings.conf;
        grp_enum.conf;
        grp_zbasic.conf"
      - CONFIG_MCUMGR_TRANSPORT_NETBUF_SIZE=2048

  smp_server.fixture.shell.mps2_an385:
    sysbuild: false
    platform_allow: [mps2/an385]
    integration_platforms: [mps2/an385]
    extra_args:
      - >-
        EXTRA_CONF_FILE="shell.conf;
        grp_os.conf;
        grp_stat.conf;
        grp_enum.conf"

  # ---------------------------------------------------------------------------
  # MCUboot serial recovery: the bootloader's own SMP server (separate from the
  # app's), entered by waiting for DFU at boot. Drive image upload against the
  # bootloader; ships the matching signed.bin to upload. Build-only hardware
  # image -- it does not fit the only MCUboot-capable QEMU target (nRF51, 16 KB
  # RAM), so a runnable emulated recovery fixture is not provided.
  # ---------------------------------------------------------------------------
  smp_server.fixture.serial_recovery.nrf52840dk:
    sysbuild: true
    platform_allow: [nrf52840dk/nrf52840]
    integration_platforms: [nrf52840dk/nrf52840]
    extra_args:
      - >-
        EXTRA_CONF_FILE="serial.conf;
        grp_os.conf;
        grp_stat.conf;
        grp_enum.conf;
        grp_img.conf"
      - SB_CONFIG_BOOTLOADER_MCUBOOT=y
      - SB_CONFIG_MERGED_HEX_FILES=y
      - mcuboot_CONFIG_MCUBOOT_SERIAL=y
      - mcuboot_CONFIG_BOOT_SERIAL_ENTRANCE_GPIO=n
      - mcuboot_CONFIG_BOOT_SERIAL_WAIT_FOR_DFU=y
      - mcuboot_CONFIG_BOOT_SERIAL_WAIT_FOR_DFU_TIMEOUT=600000
      - mcuboot_CONFIG_UART_CONSOLE=n

  # Do-it-all emulated fixture on mps2/an385: one MCUboot RAM_LOAD image hosting
  # every command group (incl. img). MCUboot serves serial recovery SMP on uart0
  # and logs on uart1; the app does the same once loaded. `os reset boot_mode=1`
  # re-enters MCUboot serial recovery on demand (retained boot mode); an upload
  # there persists across the soft reset (slots live in a non-erased RAM-backed
  # sim-flash). So a single fixture covers all groups, DFU, and recovery re-entry.
  # FILE_SUFFIX="recovery" applies the mcuboot-side RAM_LOAD layout + config
  # (sysbuild/mcuboot_recovery.{conf,overlay}); the app links for RAM execution.
  smp_server.fixture.serial_recovery.mps2_an385:
    sysbuild: true
    platform_allow: [mps2/an385]
    integration_platforms: [mps2/an385]
    extra_args:
      - &mps2_doitall_suffix FILE_SUFFIX="recovery"
      - &mps2_doitall_conf >-
        EXTRA_CONF_FILE="serial.conf;
        grp_os.conf;
        grp_fs.conf;
        grp_shell.conf;
        grp_stat.conf;
        grp_settings.conf;
        grp_enum.conf;
        grp_zbasic.conf;
        grp_img.conf;
        ramload.conf"
      - &mps2_doitall_overlay EXTRA_DTC_OVERLAY_FILE="mps2_an385_ramload_app.overlay"
      - &mps2_doitall_mcuboot SB_CONFIG_BOOTLOADER_MCUBOOT=y
      - &mps2_doitall_ramload SB_CONFIG_MCUBOOT_MODE_RAM_LOAD=y
      - &mps2_doitall_unsigned SB_CONFIG_BOOT_SIGNATURE_TYPE_NONE=y
      # mps2 defaults hex output off (no real flash); MCUboot's code-only hex is
      # the first QEMU loader.
      - &mps2_doitall_hex mcuboot_CONFIG_BUILD_OUTPUT_HEX=y
      # DEBUG verbosity throughout (mps2/an385 has the room).
      - &mps2_doitall_log CONFIG_LOG_DEFAULT_LEVEL=4
      - &mps2_doitall_mcuboot_log mcuboot_CONFIG_LOG_DEFAULT_LEVEL=4
      - &mps2_doitall_mcuboot_dbg mcuboot_CONFIG_MCUBOOT_LOG_LEVEL_DBG=y

  # mps2/an385 buffer-size matrix on the do-it-all RAM_LOAD image: the same
  # every-group-incl-img recovery fixture above, swept across
  # CONFIG_MCUMGR_TRANSPORT_NETBUF_SIZE. mps2's UART paces the link (no PTY-burst
  # fragment drop) and its 4 MB SRAM clears the RAM ceiling, so it is the
  # reliable non-bursty target the bursty native_sim and the 16 KB
  # qemu_cortex_m0 cannot be for a real buffer-filling transaction at
  # 512/1024/2048 (smpclient #73/#81). Every group is on, so a max-size message
  # round-trips three ways at each size: an os echo, an fs upload, and an img
  # (DFU) upload. 400 is the non-multiple of the 128 B client line length. Same
  # serial_recovery_* scheme as above (two QEMU loaders: MCUboot's code-only hex
  # plus the signed app dropped into slot0's RAM-backed sim-flash).
  smp_server.fixture.serial_recovery_buf400.mps2_an385:
    sysbuild: true
    platform_allow: [mps2/an385]
    integration_platforms: [mps2/an385]
    extra_args:
      - *mps2_doitall_suffix
      - *mps2_doitall_conf
      - *mps2_doitall_overlay
      - *mps2_doitall_mcuboot
      - *mps2_doitall_ramload
      - *mps2_doitall_unsigned
      - *mps2_doitall_hex
      - *mps2_doitall_log
      - *mps2_doitall_mcuboot_log
      - *mps2_doitall_mcuboot_dbg
      - CONFIG_MCUMGR_TRANSPORT_NETBUF_SIZE=400

  smp_server.fixture.serial_recovery_buf512.mps2_an385:
    sysbuild: true
    platform_allow: [mps2/an385]
    integration_platforms: [mps2/an385]
    extra_args:
      - *mps2_doitall_suffix
      - *mps2_doitall_conf
      - *mps2_doitall_overlay
      - *mps2_doitall_mcuboot
      - *mps2_doitall_ramload
      - *mps2_doitall_unsigned
      - *mps2_doitall_hex
      - *mps2_doitall_log
      - *mps2_doitall_mcuboot_log
      - *mps2_doitall_mcuboot_dbg
      - CONFIG_MCUMGR_TRANSPORT_NETBUF_SIZE=512

  smp_server.fixture.serial_recovery_buf1024.mps2_an385:
    sysbuild: true
    platform_allow: [mps2/an385]
    integration_platforms: [mps2/an385]
    extra_args:
      - *mps2_doitall_suffix
      - *mps2_doitall_conf
      - *mps2_doitall_overlay
      - *mps2_doitall_mcuboot
      - *mps2_doitall_ramload
      - *mps2_doitall_unsigned
      - *mps2_doitall_hex
      - *mps2_doitall_log
      - *mps2_doitall_mcuboot_log
      - *mps2_doitall_mcuboot_dbg
      - CONFIG_MCUMGR_TRANSPORT_NETBUF_SIZE=1024

  smp_server.fixture.serial_recovery_buf2048.mps2_an385:
    sysbuild: true
    platform_allow: [mps2/an385]
    integration_platforms: [mps2/an385]
    extra_args:
      - *mps2_doitall_suffix
      - *mps2_doitall_conf
      - *mps2_doitall_overlay
      - *mps2_doitall_mcuboot
      - *mps2_doitall_ramload
      - *mps2_doitall_unsigned
      - *mps2_doitall_hex
      - *mps2_doitall_log
      - *mps2_doitall_mcuboot_log
      - *mps2_doitall_mcuboot_dbg
      - CONFIG_MCUMGR_TRANSPORT_NETBUF_SIZE=2048
```
